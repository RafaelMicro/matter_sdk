## third_party/openthread/ot-nxp/third_party/github_sdk/sdk_2.15.1/manifest/west.yml
```yaml
# The west manifest file (west.yml) for MCUXpresso SDK delivery.
#
# See the west documentation for more information:
#
# https://docs.zephyrproject.org/latest/guides/west/index.html
manifest:
  projects:
  - name: sdk-release
    url: https://github.com/nxp-mcuxpresso/mcux-sdk.git
    revision: MCUX_2.15.100
    path: core
    import:
      name-allowlist:
        - mcux-sdk
        - FreeRTOS-Kernel
        - mcux-sdk-middleware-sdmmc
        - CMSIS_5
        - mbedtls
        - littlefs
        - lwip
        - wifi_nxp
        - mcux-sdk-middleware-connectivity-framework
```

## third_party/openthread/ot-nxp/third_party/k32w061_sdk/repo/manifest/west.yml
```yaml
#
#  Copyright (c) 2024, The OpenThread Authors.
#  All rights reserved.
#
#  Redistribution and use in source and binary forms, with or without
#  modification, are permitted provided that the following conditions are met:
#  1. Redistributions of source code must retain the above copyright
#     notice, this list of conditions and the following disclaimer.
#  2. Redistributions in binary form must reproduce the above copyright
#     notice, this list of conditions and the following disclaimer in the
#     documentation and/or other materials provided with the distribution.
#  3. Neither the name of the copyright holder nor the
#     names of its contributors may be used to endorse or promote products
#     derived from this software without specific prior written permission.
#
#  THIS SOFTWARE IS PROVIDED BY THE COPYRIGHT HOLDERS AND CONTRIBUTORS "AS IS"
#  AND ANY EXPRESS OR IMPLIED WARRANTIES, INCLUDING, BUT NOT LIMITED TO, THE
#  IMPLIED WARRANTIES OF MERCHANTABILITY AND FITNESS FOR A PARTICULAR PURPOSE
#  ARE DISCLAIMED. IN NO EVENT SHALL THE COPYRIGHT HOLDER OR CONTRIBUTORS BE
#  LIABLE FOR ANY DIRECT, INDIRECT, INCIDENTAL, SPECIAL, EXEMPLARY, OR
#  CONSEQUENTIAL DAMAGES (INCLUDING, BUT NOT LIMITED TO, PROCUREMENT OF
#  SUBSTITUTE GOODS OR SERVICES; LOSS OF USE, DATA, OR PROFITS; OR BUSINESS
#  INTERRUPTION) HOWEVER CAUSED AND ON ANY THEORY OF LIABILITY, WHETHER IN
#  CONTRACT, STRICT LIABILITY, OR TORT (INCLUDING NEGLIGENCE OR OTHERWISE)
#  ARISING IN ANY WAY OUT OF THE USE OF THIS SOFTWARE, EVEN IF ADVISED OF THE
#  POSSIBILITY OF SUCH DAMAGE.
#

# The west manifest file (west.yml) for MCUXpresso SDK delivery.
#
# See the west documentation for more information:
#
# https://docs.zephyrproject.org/latest/guides/west/index.html

manifest:
    projects:
    - name: sdk-2.6.14
      url: https://github.com/nxp-mcuxpresso/mcux-sdk.git
      revision: MCUX_2.6.14_K32W0
      path: .
      import:
        name-allowlist:
          - mcux-sdk-middleware-connectivity-framework
          - mcux-sdk-middleware-bluetooth-controller
          - mcux-sdk-middleware-bluetooth-host
          - mcux-sdk-middleware-ieee_802.15.4
          - mcux-sdk-middleware-zigbee
          - mbedtls
          - amazon-freertos
        path-prefix: core

    - name: mcux-sdk-examples
      url: https://github.com/nxp-mcuxpresso/mcux-sdk-examples.git
      revision: MCUX_2.6.14_K32W0
      path: core/boards
```
